## ezy_buf/Kconfig
```kconfig
#
# ezy buf
#    (a) a peripheral controller, and
#    (b) the gadget driver using it.
#
# NOTE:  Gadget support ** DOES NOT ** depend on host-side CONFIG_USB !!
#
#  - Host systems (like PCs) need CONFIG_USB (with "A" jacks).
#  - Peripherals (like PDAs) need CONFIG_USB_GADGET (with "B" jacks).
#  - Some systems have both kinds of controllers.
#
# With help from a special transceiver and a "Mini-AB" jack, systems with
# both kinds of controller can also support "USB On-the-Go" (CONFIG_USB_OTG).
#
menuconfig SUNNY_UVC_EZY_BUFFER
	bool "sunny uvc ezy buffer menu"
	default y
	help 
	    the sunny ezy_buf driver
config USB_G_EZYBUF
	tristate "USB UVC Buffer"
	help
	 uvc buffers

	 
```

## gdt_uvcvideo/Kconfig
```kconfig
#
# ezy buf
#    (a) a peripheral controller, and
#    (b) the gadget driver using it.
#
# NOTE:  Gadget support ** DOES NOT ** depend on host-side CONFIG_USB !!
#
#  - Host systems (like PCs) need CONFIG_USB (with "A" jacks).
#  - Peripherals (like PDAs) need CONFIG_USB_GADGET (with "B" jacks).
#  - Some systems have both kinds of controllers.
#
# With help from a special transceiver and a "Mini-AB" jack, systems with
# both kinds of controller can also support "USB On-the-Go" (CONFIG_USB_OTG).
#
menuconfig SUNNY_UVC_GADEGT
	bool "sunny uvc gadget menu"
	default y
	help 
	    the sunny uvc gadget driver
config USB_G_GADGET
	tristate "USB UVC GADGET"
	help
	 uvc GADGET

	 
```
